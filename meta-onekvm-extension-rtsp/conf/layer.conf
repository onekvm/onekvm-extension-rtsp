## meta-onekvm-extension-rtsp/conf/layer.conf
```bitbake
BBPATH .= ":${LAYERDIR}"

BBFILES += "${LAYERDIR}/recipes-*/*/*.bb \
            ${LAYERDIR}/recipes-*/*/*.bbappend"

BBFILE_COLLECTIONS += "onekvm-extension-rtsp"
BBFILE_PATTERN_onekvm-extension-rtsp := "^${LAYERDIR}/"
BBFILE_PRIORITY_onekvm-extension-rtsp = "8"

LAYERDEPENDS_onekvm-extension-rtsp = "core onekvm"
LAYERSERIES_COMPAT_onekvm-extension-rtsp = "wrynose"
```
